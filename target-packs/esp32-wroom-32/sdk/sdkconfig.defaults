## target-packs/esp32-wroom-32/sdk/sdkconfig.defaults
```kconfig
# ESP32-WROOM-32 default SDK configuration
CONFIG_ESP32_DEFAULT_CPU_FREQ_240=y
CONFIG_ESP32_DEFAULT_CPU_FREQ_MHZ=240
CONFIG_FLASHMODE_QIO=y
CONFIG_ESPTOOLPY_FLASHFREQ_40M=y
CONFIG_PARTITION_TABLE_SINGLE_APP=y
```
